## conf/distro/kpoky.conf
```bitbake
require conf/distro/poky.conf

DISTRO = "kpoky"
DISTRO_NAME = "KPOKY"
DISTRO_VERSION = "1.0"

PACKAGE_CLASSES = "package_ipk"
IMAGE_FEATURES += "package-management"
IMAGE_FEATURES += "ssh-server-dropbear"
IMAGE_INSTALL:append = " opkg"

# Ensure Machine extra deps are always included in images
IMAGE_INSTALL:append = " ${MACHINE_EXTRA_RDEPENDS}"
DISTRO_EXTRA_RDEPENDS += "i2c-tools v4l-utils networkmanager net-tools e2fsprogs-resize2fs parted android-tools openssh-sftp-server spidev-test gdb gdbserver htop tmux stress memtester rkaiq-3a-server rc-local nginx ruaps-cli extracustom-userapp sinffer devmem2 python3-pip python3-numpy python3-opencv libasan ttyd"
IMAGE_INSTALL:append = " ${DISTRO_EXTRA_RDEPENDS}"

INIT_MANAGER = "sysvinit"

# 继承自定义的 overlay class，处理最后阶段的 rootfs 文件覆盖
INHERIT += "kpoky-rootfs-overlay"

# Headless OpenCV configuration: Disable GTK, GStreamer, etc. to strip GUI dependencies
PACKAGECONFIG:pn-opencv = "python3 eigen jpeg png"

PACKAGECONFIG:append:pn-nginx = " webdav"
```

## conf/machine/rk3566-acropi.conf
```bitbake
DESCRIPTION = "Machine configuration for the RK3566 Acropi board"
TARGET_ARCH = "aarch64"

require conf/machine/include/arm/armv8-2a/tune-cortexa55.inc

PREFERRED_PROVIDER_virtual/bootloader = "u-boot"
UBOOT_MACHINE = "rk3568_defconfig"

# Updated per user request
SERIAL_CONSOLES = "1500000;ttyS2"

EXTRA_IMAGEDEPENDS += "u-boot"
RK_LOADER_BIN = "rk356x_spl_loader_v1.18.112.bin"

PREFERRED_PROVIDER_virtual/kernel = "linux-rockchip"
PREFERRED_VERSION_linux-rockchip = "6.1%"
KERNEL_IMAGETYPE = "Image"
KERNEL_DEVICETREE = "rockchip/rk3566-acropi-lp4x.dtb"
MACHINE_FEATURES = "ext2 ipa3 serial usbhost vfat"

IMAGE_FSTYPES += "ext4"

# --- USB RNDIS Hardware Support ---
MACHINE_EXTRA_RDEPENDS += "kernel-module-libcomposite kernel-module-u-ether kernel-module-usb-f-rndis kpoky-config rtl8812eu"
KERNEL_MODULE_AUTOLOAD += "libcomposite u_ether usb_f_rndis 8812eu"
```

## wic/rk3566-acropi.wks
```
# Description: Wic card image for RK3566 Acropi
#
# Part  Start Size
# idbloader 64s
# uboot 16384s
# boot 32768s 128M
# rootfs 262144s -

# 使用 idbloader.img (已软链接到 INI 指定的原始文件名)
part idbloader --source rawcopy --sourceparams="file=idbloader.img" --ondisk mmcblk --no-table --align 32
part uboot --source rawcopy --sourceparams="file=uboot.img" --ondisk mmcblk --no-table --align 8192
part boot --source bootimg-partition --ondisk mmcblk --fstype=vfat --label boot --active --align 16384
part / --source rootfs --ondisk mmcblk --fstype=ext4 --label rootfs --align 131072
```
